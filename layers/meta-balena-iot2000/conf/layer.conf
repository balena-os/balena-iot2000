## layers/meta-balena-iot2000/conf/layer.conf
```bitbake
BBPATH .= ":${LAYERDIR}"

BBFILES += "${LAYERDIR}/recipes-*/*/*.bb \
            ${LAYERDIR}/recipes-*/*/*.bbappend"

BBFILE_COLLECTIONS += "balena-iot2000"
BBFILE_PATTERN_balena-iot2000 := "^${LAYERDIR}/"
BBFILE_PRIORITY_balena-iot2000 = "1337"
```
